/*
 * Copyright (c) 2019 Intel Corporation.
 *
 * SPDX-License-Identifier: Apache-2.0
 */
/dts-v1/;

#include "hifi5s_2c_l2.dtsi"

/ {
	model = "xt-sim";
	compatible = "cdns,hifi5s_2c_l2";

	chosen {
		zephyr,sram = &sram0;
	};
};

&cpu0 {
	clock-frequency = <10000000>;
};
