## soc/cdns/hifi5s_2c_l2/Kconfig.defconfig
```kconfig
# Copyright (c) 2024 Cadence Design Systems, Inc.
# SPDX-License-Identifier: Apache-2.0

if SOC_XTENSA_HIFI5S_2C_L2

config SOC_XTENSA_HIFI5S_2C_L2
	select XTENSA_GEN_HANDLERS
	select SCHED_IPI_SUPPORTED if SMP

config MP_MAX_NUM_CPUS
	default 2

endif
```

## soc/cdns/hifi5s_2c_l2/Kconfig.soc
```kconfig
# Copyright (c) 2024 Cadence Design Systems, Inc.
# SPDX-License-Identifier: Apache-2.0

config SOC_XTENSA_HIFI5S_2C_L2
	bool

config SOC
	default "hifi5s_2c_l2" if SOC_XTENSA_HIFI5S_2C_L2

config SOC_TOOLCHAIN_NAME
	string
	default "hifi5s_2c_l2" if SOC_XTENSA_HIFI5S_2C_L2
```

## soc/cdns/hifi5s_4c_l2/Kconfig.defconfig
```kconfig
# Copyright (c) 2024 Cadence Design Systems, Inc.
# SPDX-License-Identifier: Apache-2.0

if SOC_XTENSA_HIFI5S_4C_L2

config SOC_XTENSA_HIFI5S_4C_L2
	select XTENSA_GEN_HANDLERS

config MP_MAX_NUM_CPUS
	default 4

endif
```

## soc/cdns/hifi5s_4c_l2/Kconfig.soc
```kconfig
# Copyright (c) 2024 Cadence Design Systems, Inc.
# SPDX-License-Identifier: Apache-2.0

config SOC_XTENSA_HIFI5S_4C_L2
	bool

config SOC
	default "hifi5s_4c_l2" if SOC_XTENSA_HIFI5S_4C_L2

config SOC_TOOLCHAIN_NAME
	string
	default "hifi5s_4c_l2" if SOC_XTENSA_HIFI5S_4C_L2
```
